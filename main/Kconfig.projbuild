## main/Kconfig.projbuild
```kconfig
menu "MY PROJECT configuration"

##
## LED On-devboard
choice MY_LED_ON_DEVBOARD_GPIO_NUM
    prompt "On-devboard LED GPIO#"
    default MY_LED_ON_DEVBOARD_GPIO_NUM_LOLIND32_5
    help
        The on-devboard LED GPIO# to be used.
config MY_LED_ON_DEVBOARD_GPIO_NUM_HUZZAH32_13
    bool "HUZZAH32 GPIO#13"
config MY_LED_ON_DEVBOARD_GPIO_NUM_LOLIN32LITE_22
    bool "LOLIN32LITE GPIO#22"
config MY_LED_ON_DEVBOARD_GPIO_NUM_LOLIND32_5
    bool "LOLIND32 GPIO#5"
config MY_LED_ON_DEVBOARD_GPIO_NUM_OTHER
    bool "Other GPIO#"
endchoice
config MY_LED_ON_DEVBOARD_GPIO_NUM_OTHER_VAL
    int "Other on-devboard LED GPIO#" if MY_LED_ON_DEVBOARD_GPIO_NUM_OTHER
    default 99
config MY_LED_ON_DEVBOARD_GPIO_NUM
    int
    default 13 if MY_LED_ON_DEVBOARD_GPIO_NUM_HUZZAH32_13
    default 22 if MY_LED_ON_DEVBOARD_GPIO_NUM_LOLIN32LITE_22
    default  5 if MY_LED_ON_DEVBOARD_GPIO_NUM_LOLIND32_5
    default MY_LED_ON_DEVBOARD_GPIO_NUM_OTHER_VAL if MY_LED_ON_DEVBOARD_GPIO_NUM_OTHER

choice MY_LED_ON_DEVBOARD_WIRING_TYPE
    prompt "LED on-board wiring type"
    default MY_LED_ON_DEVBOARD_WIRING_TYPE_LED_HIGH_SIDE
    help
        The LED on-board wiring type to be used.
config MY_LED_ON_DEVBOARD_WIRING_TYPE_LED_LOW_SIDE
    bool "LED_LOW_SIDE (HUZZAH32)"
config MY_LED_ON_DEVBOARD_WIRING_TYPE_LED_HIGH_SIDE
    bool "LED_HIGH_SIDE (LOLIN32LITE, LOLIND32)"
endchoice
config MY_LED_ON_DEVBOARD_WIRING_TYPE
    int
    default 1 if MY_LED_ON_DEVBOARD_WIRING_TYPE_LED_LOW_SIDE
    default 2 if MY_LED_ON_DEVBOARD_WIRING_TYPE_LED_HIGH_SIDE

##
## ADS1115
config MY_ADS1115_I2C_SLAVE_ADDRESS
    hex "MY_ADS1115_I2C_SLAVE_ADDRESS (Default 0x48)"
    default 0x48

config MY_ADS1115_I2C_MASTER_PORT_NUM
    int "MY_ADS1115_I2C_MASTER_PORT_NUM (0 = I2C_NUM_0 | 1 = I2C_NUM_1)"
    default 0

config MY_ADS1115_I2C_SCL_GPIO_NUM
    int "MY_ADS1115_I2C_SCL_GPIO_NUM (Huzzah32 #21=bottomleft | LOLIND32 #23)"
    default 23

config MY_ADS1115_I2C_SDA_GPIO_NUM
    int "MY_ADS1115_I2C_SDA_GPIO_NUM (Huzzah32 #17=bottomleft-1 | LOLIND32 #22)"
    default 22
    
config MY_ADS1115_ALERT_READY_GPIO_NUM
    int "MY_ADS1115_ALERT_READY_GPIO_NUM (-1=not used)(Huzzah32 #16=bottomleft-2 | LOLIND32 #27)"
    default -1

choice MY_ADS1115_DATA_RATE
    prompt "Data Rate, Samples Per Second (8 = preferred)"
    default MY_ADS1115_DATA_RATE_8_SPS
config MY_ADS1115_DATA_RATE_8_SPS
    bool "8 SPS"
config MY_ADS1115_DATA_RATE_64_SPS
    bool "64 SPS"
config MY_ADS1115_DATA_RATE_128_SPS
    bool "128 SPS"
config MY_ADS1115_DATA_RATE_475_SPS
    bool "475 SPS"
config MY_ADS1115_DATA_RATE_860_SPS
    bool "860 SPS"
endchoice
config MY_ADS1115_DATA_RATE
    int
    default 0 if MY_ADS1115_DATA_RATE_8_SPS
    default 3 if MY_ADS1115_DATA_RATE_64_SPS
    default 4 if MY_ADS1115_DATA_RATE_128_SPS
    default 6 if MY_ADS1115_DATA_RATE_475_SPS
    default 7 if MY_ADS1115_DATA_RATE_860_SPS

endmenu
```
